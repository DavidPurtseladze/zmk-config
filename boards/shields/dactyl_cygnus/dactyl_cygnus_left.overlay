#include "dactyl_cygnus.dtsi"

&kscan0 {
    // TODO PLACEHOLDER — still unconfirmed (left board can't be bench-tested
    // yet, see BUILD_NOTES). Right half confirmed real columns are
    // 14/15/18/19/20 in that order, innermost to outermost. Mirrored here as
    // outermost-to-innermost (pinky..index, matching left's col0..col4
    // convention): 20/19/18/15/14. Re-test once the left board's USB
    // enumeration issue is resolved.
    col-gpios
        = <&pro_micro 20 GPIO_ACTIVE_HIGH>
        , <&pro_micro 19 GPIO_ACTIVE_HIGH>
        , <&pro_micro 18 GPIO_ACTIVE_HIGH>
        , <&pro_micro 15 GPIO_ACTIVE_HIGH>
        , <&pro_micro 14 GPIO_ACTIVE_HIGH>
        ;
};
