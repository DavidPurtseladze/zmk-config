#include "dactyl_cygnus.dtsi"

&five_column_transform {
    col-offset = <5>;
};

&kscan0 {
    // CONFIRMED by bench-testing dactyl_cygnus_right_standalone_test: real
    // wiring is columns 14/15/18/19/20 in that exact order, index-stretch
    // (innermost) to pinky (outermost) -- matching the keymap's col0..col4
    // (innermost..outermost) convention. Previous guess had 14 at the wrong
    // end of the array; this is a straight reorder, not new wiring.
    col-gpios
        = <&pro_micro 14 GPIO_ACTIVE_HIGH>
        , <&pro_micro 15 GPIO_ACTIVE_HIGH>
        , <&pro_micro 18 GPIO_ACTIVE_HIGH>
        , <&pro_micro 19 GPIO_ACTIVE_HIGH>
        , <&pro_micro 20 GPIO_ACTIVE_HIGH>
        ;
};
